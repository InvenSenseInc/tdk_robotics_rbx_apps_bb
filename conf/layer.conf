## conf/layer.conf
```bitbake
BBPATH .= ":${LAYERDIR}"
BBFILES += "${LAYERDIR}/recipes/*/*.bb ${LAYERDIR}/recipes/*/*.bbappend ${LAYERDIR}/recipes-*/*/*.bb ${LAYERDIR}/recipes-*/*.bbappend"
BBFILES += "${LAYERDIR}/recipes/sensors/TDK/*/*.bb"

BBFILE_COLLECTIONS += "meta-tdk-apps"
BBFILE_PATTERN_meta-tdk-apps := "^${LAYERDIR}/"
BBFILE_PRIORITY_meta-tdk-apps = "8"

INHIBIT_PACKAGE_DEBUG_SPLIT = "1"
```
